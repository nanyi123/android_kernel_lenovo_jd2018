/* SPDX-License-Identifier: GPL-2.0 */
&mdss_mdp {
	dsi_ft8719_tbd_fhd_video: qcom,mdss_dsi_ft8719_tbd_fhd_video {
				qcom,mdss-dsi-panel-name = "ft8719 tbd fhd video mode dsi panel";
				qcom,mdss-dsi-panel-controller = <&mdss_dsi0>;
		qcom,mdss-dsi-panel-type = "dsi_video_mode";
				qcom,mdss-dsi-panel-framerate = <0x3c>;
				qcom,mdss-dsi-virtual-channel-id = <0x0>;
				qcom,mdss-dsi-stream = <0x0>;
				qcom,mdss-dsi-panel-width = <0x438>;
				qcom,mdss-dsi-panel-height = <0x8c6>;
				qcom,mdss-dsi-h-front-porch = <0x10>;
				qcom,mdss-dsi-h-back-porch = <0x10>;
				qcom,mdss-dsi-h-pulse-width = <0x4>;
				qcom,mdss-dsi-h-sync-skew = <0x0>;
				qcom,mdss-dsi-v-back-porch = <0xc>;
				qcom,mdss-dsi-v-front-porch = <0x73>;
				qcom,mdss-dsi-v-pulse-width = <0x4>;
				qcom,mdss-dsi-h-left-border = <0x0>;
				qcom,mdss-dsi-h-right-border = <0x0>;
				qcom,mdss-dsi-v-top-border = <0x0>;
				qcom,mdss-dsi-v-bottom-border = <0x0>;
				qcom,mdss-dsi-bpp = <0x18>;
				qcom,mdss-dsi-underflow-color = <0xff>;
				qcom,mdss-dsi-border-color = <0x0>;
				qcom,mdss-dsi-h-sync-pulse = <0x0>;
				qcom,mdss-dsi-traffic-mode = "burst_mode";
				qcom,mdss-dsi-bllp-eof-power-mode;
				qcom,mdss-dsi-bllp-power-mode;
				qcom,mdss-dsi-lane-0-state;
				qcom,mdss-dsi-lane-1-state;
				qcom,mdss-dsi-lane-2-state;
				qcom,mdss-dsi-lane-3-state;
				qcom,mdss-dsi-panel-timings = <0xf73c2800 0x6e702e40 0x31030400>;
				qcom,mdss-dsi-t-clk-post = <0xe>;
				qcom,mdss-dsi-t-clk-pre = <0x32>;
				qcom,mdss-dsi-bl-min-level = <0x1>;
				qcom,mdss-dsi-bl-max-level = <0xfff>;
				qcom,mdss-dsi-dma-trigger = "trigger_sw";
				qcom,mdss-dsi-mdp-trigger = "none";
				qcom,mdss-dsi-on-command = [15 01 00 00 00 00 02 00 00 29 01 00 00 00 00 04 ff 87 19 01 15 01 00 00 00 00 02 00 80 29 01 00 00 00 00 03 ff 87 19 15 01 00 00 00 00 02 00 80 29 01 00 00 00 00 0a c5 86 86 5a 5a 28 28 00 60 0c 15 01 00 00 00 00 02 00 a3 15 01 00 00 00 00 02 c5 2d 15 01 00 00 00 00 02 00 a9 15 01 00 00 00 00 02 c5 19 05 01 00 00 78 00 02 11 00 05 01 00 00 14 00 02 29 00];
				qcom,mdss-dsi-off-command = [05 01 00 00 14 00 02 28 00 05 01 00 00 78 00 02 10 00];
				qcom,mdss-dsi-on-command-state = "dsi_lp_mode";
				qcom,mdss-dsi-off-command-state = "dsi_lp_mode";
				qcom,mdss-dsi-bl-pmic-control-type = "bl_ctrl_wled";
				qcom,mdss-dsi-reset-sequence = <0x1 0xa 0x0 0x14 0x1 0x78>;
				qcom,mdss-dsi-tx-eot-append;
				qcom,mdss-dsi-post-init-delay = <0x1>;
				qcom,mdss-dsi-panel-timings-phy-v2 = <0x2420080a 0x50304a0 0x2420080a 0x50304a0 0x2420080a 0x50304a0 0x2420080a 0x50304a0 0x241d080a 0x50304a0>;
				qcom,panel-supply-entries = <&dsi_panel_pwr_supply>;
			};
};
