/* SPDX-License-Identifier: GPL-2.0 */
&mdss_mdp {
	dsi_auo_ft8716f_1080p_video: qcom,mdss_dsi_auo_ft8716f_5p9_fhd_video {
				qcom,mdss-dsi-panel-name = "AUO_FT8716F_5P9_FHD_VIDEO";
				qcom,cont-splash-enabled;
				qcom,panel-supply-entries = <&dsi_panel_pwr_supply>;
				qcom,mdss-dsi-panel-controller = <&mdss_dsi0>;
				qcom,mdss-dsi-panel-type = "dsi_video_mode";
				qcom,mdss-dsi-panel-destination = "display_1";
				qcom,mdss-dsi-panel-framerate = <0x3c>;
				qcom,mdss-dsi-virtual-channel-id = <0x0>;
				qcom,mdss-dsi-stream = <0x0>;
				qcom,mdss-dsi-panel-width = <0x438>;
				qcom,mdss-dsi-panel-height = <0x8c6>;
				qcom,mdss-dsi-h-front-porch = <0x4e>;
				qcom,mdss-dsi-h-back-porch = <0x4e>;
				qcom,mdss-dsi-h-pulse-width = <0xc>;
				qcom,mdss-dsi-h-sync-skew = <0x0>;
				qcom,mdss-dsi-v-back-porch = <0x10>;
				qcom,mdss-dsi-v-front-porch = <0x10>;
				qcom,mdss-dsi-v-pulse-width = <0x2>;
				qcom,mdss-dsi-h-left-border = <0x0>;
				qcom,mdss-dsi-h-right-border = <0x0>;
				qcom,mdss-dsi-v-top-border = <0x0>;
				qcom,mdss-dsi-v-bottom-border = <0x0>;
				qcom,mdss-dsi-bpp = <0x18>;
				qcom,mdss-dsi-color-order = "rgb_swap_rgb";
				qcom,mdss-dsi-underflow-color = <0xff>;
				qcom,mdss-dsi-border-color = <0x0>;
				qcom,mdss-dsi-cabc-off-command = <0x39010000 0x351 0xff2c3901 0x0 0x2532c39 0x1000000 0x25500>;
				qcom,mdss-dsi-on-command = [39 01 00 00 00 00 02 00 00 39 01 00 00 00 00 04 ff 87 16 01 39 01 00 00 00 00 02 00 80 39 01 00 00 00 00 03 ff 87 16 39 01 00 00 00 00 02 00 00 39 01 00 00 00 00 05 2a 00 00 04 37 39 01 00 00 00 00 02 00 00 39 01 00 00 00 00 05 2b 00 00 08 c5 39 01 00 00 00 00 02 00 b0 39 01 00 00 00 00 03 ca 00 00 39 01 00 00 00 00 02 00 b2 39 01 00 00 00 00 02 ca 04 39 01 00 00 00 00 02 00 b5 39 01 00 00 00 00 02 ca 20 39 01 00 00 00 00 02 00 80 39 01 00 00 00 00 10 c0 00 74 00 10 10 00 74 10 10 00 74 00 10 10 00 39 01 00 00 00 00 02 00 90 39 01 00 00 00 00 09 ce 00 5c 0b 75 00 5c 00 12 39 01 00 00 00 00 02 00 b0 39 01 00 00 00 00 04 ce 04 00 72 39 01 00 00 00 00 02 00 9b 39 01 00 00 00 00 04 ce 01 16 07 39 01 00 00 00 00 02 00 b0 39 01 00 00 00 00 05 c5 10 00 00 00 39 01 00 00 00 00 02 00 c1 39 01 00 00 00 00 02 c5 44 39 01 00 00 00 00 02 00 80 39 01 00 00 00 00 02 c4 41 39 01 00 00 00 00 02 00 94 39 01 00 00 00 00 02 c5 66 39 01 00 00 00 00 02 00 98 39 01 00 00 00 00 03 c5 56 60 39 01 00 00 00 00 02 00 88 39 01 00 00 00 00 03 c3 22 22 39 01 00 00 00 00 02 00 98 39 01 00 00 00 00 03 c3 22 22 39 01 00 00 00 00 02 00 d6 39 01 00 00 00 00 02 c0 08 39 01 00 00 00 00 02 00 81 39 01 00 00 00 00 0a ca f0 ff c8 ff b4 ff 00 00 00 39 01 00 00 00 00 02 00 00 39 01 00 00 00 00 02 c6 10 39 01 00 00 00 00 02 00 00 39 01 00 00 00 00 13 c7 a0 ac ac ba cd aa bb cb ca bb ca ab ab 78 56 34 12 11 39 01 00 00 00 00 02 00 00 39 01 00 00 00 00 02 c6 11 39 01 00 00 00 00 02 00 00 39 01 00 00 00 00 13 c7 a0 ab 9c ab cc 9b ba cb b9 bb ba bb a9 78 56 34 12 11 39 01 00 00 00 00 02 00 00 39 01 00 00 00 00 02 c6 12 39 01 00 00 00 00 02 00 00 39 01 00 00 00 00 13 c7 a0 ba 9b aa cc 9a aa cb aa ba ba aa 9a 78 56 34 12 11 39 01 00 00 00 00 02 00 00 39 01 00 00 00 00 02 c6 13 39 01 00 00 00 00 02 00 00 39 01 00 00 00 00 13 c7 90 ab 9b 9a bc 9b a9 ca 9a aa ab aa a9 78 56 34 12 11 39 01 00 00 00 00 02 00 00 39 01 00 00 00 00 02 c6 14 39 01 00 00 00 00 02 00 00 39 01 00 00 00 00 13 c7 90 aa 9b a9 ca 9a a9 ba 9a aa ba a9 99 78 56 34 12 11 39 01 00 00 00 00 02 00 00 39 01 00 00 00 00 02 c6 15 39 01 00 00 00 00 02 00 00 39 01 00 00 00 00 13 c7 90 9a 8b 9a bb 9a 99 ba 9a a8 ca 99 99 88 56 34 12 11 39 01 00 00 00 00 02 00 00 39 01 00 00 00 00 02 c6 16 39 01 00 00 00 00 02 00 00 39 01 00 00 00 00 13 c7 90 9a 9a 99 ba 9a 98 aa aa 98 ba 8a 89 88 67 45 23 11 39 01 00 00 00 00 02 00 00 39 01 00 00 00 00 02 c6 17 39 01 00 00 00 00 02 00 00 39 01 00 00 00 00 13 c7 90 99 9a 99 b9 a9 98 a9 aa 88 ba 8a 98 88 78 45 23 22 39 01 00 00 00 00 02 00 00 39 01 00 00 00 00 02 c6 18 39 01 00 00 00 00 02 00 00 39 01 00 00 00 00 13 c7 80 9a 8a 99 a9 8a 89 a9 9a 98 b9 99 88 88 78 56 34 23 39 01 00 00 00 00 02 00 00 39 01 00 00 00 00 02 c6 19 39 01 00 00 00 00 02 00 00 39 01 00 00 00 00 13 c7 80 99 8a 89 b9 99 98 a8 a9 88 a9 9a 87 88 88 67 35 33 39 01 00 00 00 00 02 00 00 39 01 00 00 00 00 02 c6 1a 39 01 00 00 00 00 02 00 00 39 01 00 00 00 00 13 c7 80 99 99 88 a9 99 98 98 a9 79 a9 99 88 88 88 67 45 44 39 01 00 00 00 00 02 00 00 39 01 00 00 00 00 02 c6 1b 39 01 00 00 00 00 02 00 00 39 01 00 00 00 00 13 c7 80 98 99 89 89 99 89 98 99 79 99 8a 88 88 88 78 56 44 39 01 00 00 00 00 02 00 00 39 01 00 00 00 00 02 c6 1c 39 01 00 00 00 00 02 00 00 39 01 00 00 00 00 13 c7 80 98 89 89 89 89 89 98 a8 88 98 99 78 88 88 88 57 55 39 01 00 00 00 00 02 00 00 39 01 00 00 00 00 02 c6 1d 39 01 00 00 00 00 02 00 00 39 01 00 00 00 00 13 c7 a0 88 89 89 98 98 88 98 89 98 97 89 88 88 88 88 67 66 39 01 00 00 00 00 02 00 00 39 01 00 00 00 00 02 c6 1e 39 01 00 00 00 00 02 00 00 39 01 00 00 00 00 13 c7 a0 88 89 88 88 89 88 98 98 88 88 89 88 88 88 88 78 67 39 01 00 00 00 00 02 00 00 39 01 00 00 00 00 02 c6 1f 39 01 00 00 00 00 02 00 00 39 01 00 00 00 00 13 c7 70 88 88 88 88 89 88 88 98 87 98 88 88 88 88 88 88 78 39 01 00 00 00 00 02 00 00 39 01 00 00 00 00 02 c6 00 39 01 00 00 00 00 02 00 00 39 01 00 00 00 00 04 ff 00 00 00 39 01 00 00 00 00 02 00 80 39 01 00 00 00 00 03 ff 00 00 39 01 00 00 00 00 02 35 00 39 01 00 00 00 00 03 51 ff 03 39 01 00 00 00 00 02 53 24 39 01 00 00 00 00 02 55 03 39 01 00 00 7f 00 01 11 39 01 00 00 1f 00 01 29];
				qcom,mdss-dsi-cabc-on-command = [39 01 00 00 00 00 02 00 00 39 01 00 00 00 00 04 ff 87 16 01 39 01 00 00 00 00 02 00 80 39 01 00 00 00 00 03 ff 87 16 39 01 00 00 00 00 02 00 00 39 01 00 00 00 00 05 2a 00 00 04 37 39 01 00 00 00 00 02 00 00 39 01 00 00 00 00 05 2b 00 00 08 c5 39 01 00 00 00 00 02 00 b0 39 01 00 00 00 00 03 ca 00 00 39 01 00 00 00 00 02 00 b2 39 01 00 00 00 00 02 ca 04 39 01 00 00 00 00 02 00 b5 39 01 00 00 00 00 02 ca 20 39 01 00 00 00 00 02 00 80 39 01 00 00 00 00 10 c0 00 74 00 10 10 00 74 10 10 00 74 00 10 10 00 39 01 00 00 00 00 02 00 90 39 01 00 00 00 00 09 ce 00 5c 0b 75 00 5c 00 12 39 01 00 00 00 00 02 00 b0 39 01 00 00 00 00 04 ce 04 00 72 39 01 00 00 00 00 02 00 9b 39 01 00 00 00 00 04 ce 01 16 07 39 01 00 00 00 00 02 00 b0 39 01 00 00 00 00 05 c5 10 00 00 00 39 01 00 00 00 00 02 00 c1 39 01 00 00 00 00 02 c5 44 39 01 00 00 00 00 02 00 80 39 01 00 00 00 00 02 c4 41 39 01 00 00 00 00 02 00 94 39 01 00 00 00 00 02 c5 66 39 01 00 00 00 00 02 00 98 39 01 00 00 00 00 03 c5 56 60 39 01 00 00 00 00 02 00 88 39 01 00 00 00 00 03 c3 22 22 39 01 00 00 00 00 02 00 98 39 01 00 00 00 00 03 c3 22 22 39 01 00 00 00 00 02 00 d6 39 01 00 00 00 00 02 c0 08 39 01 00 00 00 00 02 00 81 39 01 00 00 00 00 0a ca f0 ff c8 ff b4 ff 00 00 00 39 01 00 00 00 00 02 00 00 39 01 00 00 00 00 02 c6 10 39 01 00 00 00 00 02 00 00 39 01 00 00 00 00 13 c7 a0 ac ac ba cd aa bb cb ca bb ca ab ab 78 56 34 12 11 39 01 00 00 00 00 02 00 00 39 01 00 00 00 00 02 c6 11 39 01 00 00 00 00 02 00 00 39 01 00 00 00 00 13 c7 a0 ab 9c ab cc 9b ba cb b9 bb ba bb a9 78 56 34 12 11 39 01 00 00 00 00 02 00 00 39 01 00 00 00 00 02 c6 12 39 01 00 00 00 00 02 00 00 39 01 00 00 00 00 13 c7 a0 ba 9b aa cc 9a aa cb aa ba ba aa 9a 78 56 34 12 11 39 01 00 00 00 00 02 00 00 39 01 00 00 00 00 02 c6 13 39 01 00 00 00 00 02 00 00 39 01 00 00 00 00 13 c7 90 ab 9b 9a bc 9b a9 ca 9a aa ab aa a9 78 56 34 12 11 39 01 00 00 00 00 02 00 00 39 01 00 00 00 00 02 c6 14 39 01 00 00 00 00 02 00 00 39 01 00 00 00 00 13 c7 90 aa 9b a9 ca 9a a9 ba 9a aa ba a9 99 78 56 34 12 11 39 01 00 00 00 00 02 00 00 39 01 00 00 00 00 02 c6 15 39 01 00 00 00 00 02 00 00 39 01 00 00 00 00 13 c7 90 9a 8b 9a bb 9a 99 ba 9a a8 ca 99 99 88 56 34 12 11 39 01 00 00 00 00 02 00 00 39 01 00 00 00 00 02 c6 16 39 01 00 00 00 00 02 00 00 39 01 00 00 00 00 13 c7 90 9a 9a 99 ba 9a 98 aa aa 98 ba 8a 89 88 67 45 23 11 39 01 00 00 00 00 02 00 00 39 01 00 00 00 00 02 c6 17 39 01 00 00 00 00 02 00 00 39 01 00 00 00 00 13 c7 90 99 9a 99 b9 a9 98 a9 aa 88 ba 8a 98 88 78 45 23 22 39 01 00 00 00 00 02 00 00 39 01 00 00 00 00 02 c6 18 39 01 00 00 00 00 02 00 00 39 01 00 00 00 00 13 c7 80 9a 8a 99 a9 8a 89 a9 9a 98 b9 99 88 88 78 56 34 23 39 01 00 00 00 00 02 00 00 39 01 00 00 00 00 02 c6 19 39 01 00 00 00 00 02 00 00 39 01 00 00 00 00 13 c7 80 99 8a 89 b9 99 98 a8 a9 88 a9 9a 87 88 88 67 35 33 39 01 00 00 00 00 02 00 00 39 01 00 00 00 00 02 c6 1a 39 01 00 00 00 00 02 00 00 39 01 00 00 00 00 13 c7 80 99 99 88 a9 99 98 98 a9 79 a9 99 88 88 88 67 45 44 39 01 00 00 00 00 02 00 00 39 01 00 00 00 00 02 c6 1b 39 01 00 00 00 00 02 00 00 39 01 00 00 00 00 13 c7 80 98 99 89 89 99 89 98 99 79 99 8a 88 88 88 78 56 44 39 01 00 00 00 00 02 00 00 39 01 00 00 00 00 02 c6 1c 39 01 00 00 00 00 02 00 00 39 01 00 00 00 00 13 c7 80 98 89 89 89 89 89 98 a8 88 98 99 78 88 88 88 57 55 39 01 00 00 00 00 02 00 00 39 01 00 00 00 00 02 c6 1d 39 01 00 00 00 00 02 00 00 39 01 00 00 00 00 13 c7 a0 88 89 89 98 98 88 98 89 98 97 89 88 88 88 88 67 66 39 01 00 00 00 00 02 00 00 39 01 00 00 00 00 02 c6 1e 39 01 00 00 00 00 02 00 00 39 01 00 00 00 00 13 c7 a0 88 89 88 88 89 88 98 98 88 88 89 88 88 88 88 78 67 39 01 00 00 00 00 02 00 00 39 01 00 00 00 00 02 c6 1f 39 01 00 00 00 00 02 00 00 39 01 00 00 00 00 13 c7 70 88 88 88 88 89 88 88 98 87 98 88 88 88 88 88 88 78 39 01 00 00 00 00 02 00 00 39 01 00 00 00 00 02 c6 00 39 01 00 00 00 00 02 00 00 39 01 00 00 00 00 04 ff 00 00 00 39 01 00 00 00 00 02 00 80 39 01 00 00 00 00 03 ff 00 00 39 01 00 00 00 00 02 35 00 39 01 00 00 00 00 03 51 ff 03 39 01 00 00 00 00 02 53 24 39 01 00 00 00 00 02 55 03 39 01 00 00 7f 00 01 11 39 01 00 00 1f 00 01 29];
				qcom,mdss-dsi-off-command = <0x5010000 0x1c000128 0x5010000 0x64000110 0x39010000 0x200 0x390100 0x4 0xff871601 0x39010000 0x200 0x80390100 0x3 0xff871639 0x1000000 0x20000 0x39010000 0x5f7 0x5aa58716>;
				qcom,mdss-dsi-panel-timings-phy-v2 = <0x2520090a 0x60304a0 0x2520090a 0x60304a0 0x2520090a 0x60304a0 0x2520090a 0x60304a0 0x251f090a 0x60304a0>;
				qcom,mdss-dsi-tx-eot-append;
				/* ESD check disabled: 4.19 MDSS fails HS-mode reg_read after
				 * resume (mdss_dsi_gen_read_status incorrect -> PANEL_ALIVE=0
				 * -> black screen). 4.4 stock driver handled it, 4.19 doesn't.
				 * Re-enable only after verifying HS read works post-resume.
				qcom,esd-check-enabled;
				qcom,mdss-dsi-panel-status-command = <0x6010001 0x500010a>;
				qcom,mdss-dsi-panel-status-command-state = "dsi_hs_mode";
				qcom,mdss-dsi-panel-status-check-mode = "reg_read";
				qcom,mdss-dsi-panel-status-read-length = <0x1>;
				qcom,mdss-dsi-panel-status-valid-params = <0x1>;
				qcom,mdss-dsi-panel-status-value = <0x9c>;
				qcom,mdss-dsi-panel-max-error-count = <0x3>;
				 */
				qcom,mdss-dsi-on-command-state = "dsi_lp_mode";
				qcom,mdss-dsi-off-command-state = "dsi_lp_mode";
				qcom,mdss-dsi-h-sync-pulse = <0x1>;
				qcom,mdss-dsi-traffic-mode = "burst_mode";
				qcom,mdss-dsi-lane-map = "lane_map_0123";
				qcom,mdss-dsi-bllp-eof-power-mode;
				qcom,mdss-dsi-bllp-power-mode;
				qcom,mdss-dsi-lp11-init;
				qcom,mdss-dsi-init-delay-us = <0x2710>;
				qcom,mdss-dsi-lane-0-state;
				qcom,mdss-dsi-lane-1-state;
				qcom,mdss-dsi-lane-2-state;
				qcom,mdss-dsi-lane-3-state;
				qcom,mdss-dsi-t-clk-post = <0x6b>;
				qcom,mdss-dsi-t-clk-pre = <0x7>;
				qcom,mdss-dsi-bl-min-level = <0x1>;
				qcom,mdss-dsi-bl-max-level = <0xfff>;
				qcom,mdss-brightness-max-level = <0xfff>;
				qcom,mdss-dsi-dma-trigger = "trigger_sw";
				qcom,mdss-dsi-mdp-trigger = "none";
				qcom,mdss-dsi-bl-pmic-control-type = "bl_ctrl_wled";
				qcom,mdss-dsi-reset-sequence = <0x1 0x5 0x0 0x5 0x1 0x32>;
			};
};
